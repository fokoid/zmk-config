/*
 * Copyright (c) 2020 The ZMK Contributors
 *
 * SPDX-License-Identifier: MIT
 */

#include <behaviors.dtsi>
#include <dt-bindings/zmk/keys.h>
#include <dt-bindings/zmk/bt.h>

/ {
    keymap {
        compatible = "zmk,keymap";

        default_layer {

            bindings = <
	&kp C_PLAY_PAUSE &kp C_PREV &kp C_NEXT &kp C_MUTE
            >;

        };
    };
};
