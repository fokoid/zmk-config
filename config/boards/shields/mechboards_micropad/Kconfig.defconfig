## config/boards/shields/mechboards_micropad/Kconfig.defconfig
```kconfig
if SHIELD_MECHBOARDS_MICROPAD

config ZMK_KEYBOARD_NAME
    default "MBUK Micropad"

endif
```

## config/boards/shields/mechboards_micropad/Kconfig.shield
```kconfig
config SHIELD_MECHBOARDS_MICROPAD
    def_bool $(shields_list_contains,mechboards_micropad)
```
